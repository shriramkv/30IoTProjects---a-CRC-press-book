#include <Wire.h> //Used for I2C functionalities
#include <MAX30100_PulseOximeter.h> //Used for MAX30100 Pulse oximeter
#include <OakOLED.h> //Used for OLED module

#define TIME_PERIOD 1 //Delay in seconds
#define SpO2_THRES 94 //Threshold for safe oxygen saturation
#define buzzer 2 //Digital pin to which buzzer is connected

OakOLED display; //OakOLED object
PulseOximeter pox; //PulseOximeter object

//Variables used for controlling the pulse oximeter & buzzer
unsigned long prevTime = 0;
int bpm;
int SpO2;
bool buzzerState = false;

//Bitmap of heart rate image [64x34px, 160 brightness]
const unsigned char heart [] PROGMEM = {
  0x00, 0x00, 0x07, 0xc0, 0x01, 0xf0, 0x00, 0x00, 0x00, 0x00, 0x1f, 0xf8, 0x0f, 0xfc, 0x00, 0x00, 
  0x00, 0x00, 0x7f, 0xfc, 0x1f, 0xff, 0x00, 0x00, 0x00, 0x00, 0xff, 0xfe, 0x3f, 0xff, 0x80, 0x00, 
  0x00, 0x01, 0xff, 0xff, 0xff, 0xff, 0xc0, 0x00, 0x00, 0x01, 0xff, 0xff, 0xff, 0xff, 0xc0, 0x00, 
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  0x00, 0x00, 0x00, 0x03, 0xe0, 0x00, 0x00, 0x00, 0x00, 0x00, 0x00, 0x01, 0xc0, 0x00, 0x00, 0x00
};

//Bitmap of oxygen saturation image [64x34px, 120 brightness]
const unsigned char oxysat [] PROGMEM = {
  0x00, 0x00, 0x00, 0x00, 0x00, 0x00, 0x00, 0x00, 0x00, 0x00, 0x00, 0x00, 0x00, 0x00, 0x00, 0x00, 
  0x00, 0x00, 0x00, 0x00, 0x00, 0x00, 0x00, 0x00, 0x00, 0x00, 0x00, 0x00, 0x00, 0x00, 0x00, 0x00, 
  0x00, 0x00, 0x00, 0x00, 0x00, 0x00, 0x00, 0x00, 0x00, 0x00, 0x00, 0x00, 0x00, 0x00, 0x00, 0x00, 
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  0x00, 0x00, 0x00, 0x3f, 0x80, 0x00, 0x00, 0x00, 0x00, 0x00, 0x00, 0x00, 0x00, 0x00, 0x00, 0x00
};

//Function executed when a heart beat is detected
void onBeatDetected() {
  Serial.println("Beat! ♥");
}
 
void setup() {
  Serial.begin(9600); //Initialisation of Arduino's Serial
  pinMode(buzzer, OUTPUT); //Direction of buzzer
  
  display.begin(); //Initialisation of OLED module
  //Initial display configurations
  display.clearDisplay();
  display.setTextSize(1);
  display.setTextColor(0);
   
  if (!pox.begin()){ //Initialisation of pulse oximeter module
    Serial.println("Initialisation of MAX30100 FAILED.");
    while(1);
  } else
    Serial.println("MAX30100 Successfully Initialised.");

  //Initial pulse oximeter configurations
  pox.setIRLedCurrent(MAX30100_LED_CURR_7_6MA);
  pox.setOnBeatDetectedCallback(onBeatDetected);
}
 
void loop() {
  pox.update(); //Run the update as fast as possible
  //Run once for every TIME_PERIOD seconds
  if (millis()/1000 - prevTime > TIME_PERIOD) {
    bpm = pox.getHeartRate(); //Calculate the heart rate
    SpO2 = constrain(pox.getSpO2(), 0, 100); //Calculate the oxygen saturation
    
    Serial.print("Heart rate: ");
    Serial.print(bpm);
    Serial.print("bpm  SpO2: ");
    Serial.print(SpO2);
    Serial.println("%");
    prevTime = millis()/1000;

    //Switch ON the buzzer if oxygen saturation is below safe threshold
    if(SpO2 != 0 && SpO2 < SpO2_THRES && !buzzerState){
      digitalWrite(buzzer, HIGH);
      buzzerState = true;
    } else if(SpO2 != 0 && SpO2 < SpO2_THRES && buzzerState) {
      digitalWrite(buzzer, LOW);
      buzzerState = false;
    } else
      digitalWrite(buzzer, LOW);

    //Display the heart rate and oxygen saturation on the OLED
    display.clearDisplay();

    display.setCursor(0,0);
    display.print("Heart Rate:");
    display.setCursor(0,10);
    display.print(bpm);
    display.print(" bpm");
     
    display.setCursor(74,0);
    display.print("SpO2:");
    display.setCursor(74,10);
    display.print(SpO2);
    display.print(" %");

    display.drawBitmap(0, 25, heart, 64, 34, 1);
    display.drawBitmap(64, 25, oxysat, 64, 34, 1);
    display.display();
  }
}
